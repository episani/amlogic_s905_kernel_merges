## hardware/amlogic/nand/aml_nftl_new/Kconfig
```kconfig
#
# Amlogic NAND device configuration
#

menu "Meson NAND Device Support"

config AML_NFTL_MODULES
	tristate "Meson NAND NEW_FTL DEV support"
	default n
	help
	  Support NAND Flash New Translation Layer

endmenu
        
```

## hardware/amlogic/nand/amlnf_3.14/Kconfig
```kconfig
#
# Amlogic NAND device configuration
#

menuconfig AML_NAND
	bool "Meson NAND Device Support(For NEXT GEN NAND DRIV)"
	default n
	help
	  Amlogic nand drvier support.
	  when it is Y here, we use aml nand driver, need choice below;
	  when it is n here, need not other choice,we do not use aml nand
	  driver.

if	AML_NAND

config AML_NFTL_NEW
	tristate "Meson NAND flash new nftl"
	default m
	help
	  Support for NAND flash
	  on Amlogic Meson platforms
	  for Next nftl
	  here
endif
```

## linux/drivers/amlogic/Kconfig
```kconfig
#
# Amlogic driver configuration
#
menu "Amlogic Device Drivers"
#
#       Char devices
#
comment "Char devices"
source "drivers/amlogic/uart/Kconfig"
source "drivers/amlogic/rtc/Kconfig"
source "drivers/amlogic/i2c/Kconfig"
source "drivers/amlogic/input/Kconfig"
#source "drivers/amlogic/gpio/Kconfig"
source "drivers/amlogic/pinctrl/Kconfig"
source "drivers/amlogic/power/Kconfig"
source "drivers/amlogic/securitykey/Kconfig"
source "drivers/amlogic/key_manage/Kconfig"
source "drivers/amlogic/efuse/Kconfig"
source "drivers/amlogic/thermal/Kconfig"
source "drivers/amlogic/watchdog/Kconfig"
#
#       Block devices
#
comment "Block devices"
source "drivers/amlogic/usb/Kconfig"
source "drivers/amlogic/mmc/Kconfig"
source "drivers/amlogic/amlnf/Kconfig"
#source "../hardware/amlogic/nand/amlnf_3.14/Kconfig"
#source "../hardware/amlogic/nand/nand/Kconfig"
#
#      Network devices
#
#comment "Network devices"
source "drivers/amlogic/ethernet/Kconfig"
source "drivers/amlogic/wifi/Kconfig"
#
source "../hardware/amlogic/wifi/broadcom/drivers/ap6xxx/bcmdhd_1_201_59_x/Kconfig"
source "../hardware/amlogic/wifi/broadcom/drivers/ap6xxx/broadcm_40181/Kconfig"
source "../hardware/amlogic/wifi/broadcom/drivers/ap6xxx/broadcm_4354/Kconfig"
#source "../hardware/amlogic/wifi/broadcom/drivers/usi/bcmdhd/Kconfig"
source "../hardware/amlogic/wifi/realtek/drivers/8188eu/rtl8xxx_EU/Kconfig"
source "../hardware/amlogic/wifi/realtek/drivers/8189fs/rtl8189FS/Kconfig"
source "../hardware/amlogic/wifi/realtek/drivers/8192cu/rtl8xxx_CU/Kconfig"
source "../hardware/amlogic/wifi/realtek/drivers/8192du/rtl8xxx_DU/Kconfig"
source "../hardware/amlogic/wifi/realtek/drivers/8192eu/rtl8192EU/Kconfig"
source "../hardware/amlogic/wifi/realtek/drivers/8189es/rtl8189ES/Kconfig"
source "../hardware/amlogic/wifi/realtek/drivers/8723bs/rtl8723BS/Kconfig"
source "../hardware/amlogic/wifi/realtek/drivers/8723au/rtl8723AU/Kconfig"
source "../hardware/amlogic/wifi/realtek/drivers/8723bu/rtl8723BU/Kconfig"
source "../hardware/amlogic/wifi/realtek/drivers/8811au/rtl8811AU/Kconfig"
source "../hardware/amlogic/wifi/realtek/drivers/8812au/rtl8812AU/Kconfig"


source "drivers/amlogic/bluetooth/Kconfig"


#
#  Audio
#
comment "Audio devices"
source "drivers/amlogic/amaudio/Kconfig"
source "drivers/amlogic/amaudio2/Kconfig"
source "drivers/amlogic/audiodsp/Kconfig"


#
#  Video
#
comment "Video devices"
source "drivers/amlogic/vfm/Kconfig"
source "drivers/amlogic/amports/Kconfig"
source "drivers/amlogic/canvas/Kconfig"
source "drivers/amlogic/display/Kconfig"
source "drivers/amlogic/led/Kconfig"
source "drivers/amlogic/hdmi/Kconfig"
source "drivers/amlogic/tvin/Kconfig"
source "drivers/amlogic/ppmgr/Kconfig"
source "drivers/amlogic/camera/Kconfig"
source "drivers/amlogic/video_dev/Kconfig"
source "drivers/amlogic/ionvideo/Kconfig"
source "drivers/amlogic/deinterlace/Kconfig"
source "drivers/amlogic/amvecm/Kconfig"
source "drivers/amlogic/dvb_tv/Kconfig"


#
#       GPU
#
comment "GPU (ARM Mali)"
source "../hardware/amlogic/gpu/ump/Kconfig"
source "../hardware/amlogic/gpu/mali/Kconfig"


#
# Other
#
source "../hardware/amlogic/pmu/Kconfig"
source "../hardware/amlogic/touch/Kconfig"

source "drivers/amlogic/clocksource/Kconfig"
source "drivers/amlogic/cpu_version/Kconfig"
source "drivers/amlogic/iomap/Kconfig"
source "drivers/amlogic/vrtc/Kconfig"
source "drivers/amlogic/irblaster/Kconfig"
source "drivers/amlogic/aml_debug/Kconfig"
source "drivers/amlogic/reg_access/Kconfig"
source "drivers/amlogic/vpu/Kconfig"
source "drivers/amlogic/clk/Kconfig"
source "drivers/amlogic/secmon/Kconfig"
source "drivers/amlogic/reset/Kconfig"
source "drivers/amlogic/amlnf/Kconfig"
source "drivers/amlogic/cpufreq/Kconfig"
source "drivers/amlogic/pm/Kconfig"
source "drivers/amlogic/mailbox/Kconfig"
source "drivers/amlogic/rdma/Kconfig"
source "drivers/amlogic/audinfo_kernel/Kconfig"
source "drivers/amlogic/instaboot/Kconfig"
source "drivers/amlogic/codec_mm/Kconfig"
source "drivers/amlogic/pwm/Kconfig"

endmenu
```
